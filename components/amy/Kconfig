## components/usb_device_uac/Kconfig.uac
```kconfig
menu "USB Device UAC"

    config USB_DEVICE_UAC_AS_PART
        bool "Using customer tinyusb configs and descriptors"
        default n
        help
            If enable this feature, will need to write the `tusb_config.h` and `usb_descriptors.c` files in the project.

    config UAC_SPEAKER_CHANNEL_NUM
        int "UAC Speaker channel number"
        range 0 8
        default 1

    config UAC_MIC_CHANNEL_NUM
        int "UAC mic channel number"
        range 0 4
        default 1

    config UAC_SAMPLE_RATE
        int "UAC sample rate"
        default 48000

    config UAC_SPK_INTERVAL_MS
        int "UAC SPK interval(ms)"
        default 10
        help
            SPK: The first interval of reading data from UAC device, in ms. And make SPK FIFO to accommodate data of size n milliseconds.

    config UAC_MIC_INTERVAL_MS
        int "UAC MIC interval(ms)"
        default 10
        help
            MIC: The interval of writing data to UAC device, in ms. Batch fetching data helps reduce latency at the slave end. And make MIC FIFO to accommodate data of size n milliseconds.

    # LOCAL EDIT (S3-Amysynth): the MIC EP-IN software FIFO depth was
    # hardwired to (UAC_MIC_INTERVAL_MS + 1) packets - too shallow for
    # TinyUSB's EP-IN flow control (see tusb_config_uac.h). Expose it.
    config UAC_MIC_FIFO_DEPTH_MS
        int "MIC EP-IN software FIFO depth (ms)"
        default 10
        range 4 64
        depends on UAC_MIC_CHANNEL_NUM != 0
        help
            Depth of the TinyUSB endpoint-IN software FIFO in milliseconds of
            audio. TinyUSB's flow control steers the fill level toward HALF
            this depth, so steady-state capture latency and the jitter margin
            on each side are both about depth/2; the stream-start prefill
            follows this value automatically. Constraints: TinyUSB flow
            control needs at least 4 packets (4 ms), and the value must
            exceed 2*UAC_MIC_INTERVAL_MS or the refill gate can never reach
            the setpoint (the fill would be pinned below it and the stream
            rides one scheduling hiccup away from an audible zero-length
            packet). Larger = more robust, more latent; smaller = tighter,
            riskier.

    config UAC_SPK_NEW_PLAY_INTERVAL
        int "UAC SPK new play interval(ms)"
        default 100
        help
            SPK: A new playback is considered if it has been longer than a certain number of milliseconds since the last audio data was received.

    config UAC_SUPPORT_MACOS
        bool "Support MacOS"
        default n
        help
            Enable conversion from 16.16 to 10.14 format on full-speed devices on MacOS.

    menu "UAC Task Config"
            config UAC_TINYUSB_TASK_PRIORITY
                int "Tinyusb task priority"
                default 5
                range 1 15

            config UAC_TINYUSB_TASK_CORE
                int "Tinyusb task core"
                default -1
                range -1 1

            config UAC_SPK_TASK_PRIORITY
                int "SPK task priority"
                default 5
                range 1 15
                depends on UAC_SPEAKER_CHANNEL_NUM != 0

            config UAC_SPK_TASK_CORE
                int "SPK task core"
                default -1
                range -1 1
                depends on UAC_SPEAKER_CHANNEL_NUM != 0

            config UAC_MIC_TASK_PRIORITY
                int "MIC task priority"
                default 5
                range 1 15
                depends on UAC_MIC_CHANNEL_NUM != 0

            config UAC_MIC_TASK_CORE
                int "MIC task core"
                default -1
                range -1 1
                depends on UAC_MIC_CHANNEL_NUM != 0
    endmenu

endmenu
```

## components/usb_importer/Kconfig
```kconfig
config SYNTH_USB_IMPORT
	bool "Song import over USB WebSerial (USB CDC port)"
	depends on SYNTH_PROJECT_STORE
	default y
	help
		Adds a USB CDC (serial) interface alongside the USB audio stream:
		plug the board into any computer, open tools/usb_import.html in a
		browser (WebSerial over a secure context), and paste or upload an
		AMYSONG text file - or a .mid, converted on the device with the
		same converter the WiFi page uses - into a project slot. Runs on
		the CDC pump task; the actual song apply runs on the sequencer's
		single-applier ui task, identical to the WiFi importer.
```

## components/wifi_importer/Kconfig
```kconfig
config SYNTH_WIFI_IMPORT
	bool "Song import over WiFi (SoftAP + web upload)"
	depends on SYNTH_PROJECT_STORE
	default n
	help
		Runs a Wireless SoftAP ("AMYSYNTH") with a bare HTTP server on
		http://192.168.4.1/. The page uploads or pastes an AMYSONG text
		file; the firmware parses it into the sequencer (through the
		single-applier ui task) and saves it into a project slot for
		later Load. Compiles in the ESP-IDF wifi + netif + lwIP stacks.

config SYNTH_WIFI_AP_SSID
	string "AMYSYNTH SoftAP SSID"
	depends on SYNTH_WIFI_IMPORT
	default "AMYSYNTH"
	help
		Network name broadcast by the song-import access point. Open
		(no password): the page only writes project slots on the local
		link, so an open AP saves the code from holding a PSK.

config SYNTH_WIFI_AP_CHANNEL
	int "AMYSYNTH SoftAP channel"
	depends on SYNTH_WIFI_IMPORT
	default 1
	range 1 13
	help
		Wi-Fi channel for the import AP.
```

## components/wireless/Kconfig
```kconfig
menu "Wireless (BLE MIDI)"

config SYNTH_WIRELESS
	bool "Wireless support (BLE MIDI in)"
	depends on BT_ENABLED && BT_NIMBLE_ENABLED
	default n
	help
		On-demand BLE MIDI input: a "Wireless" menu page starts a NimBLE
		peripheral session (advertises the BLE-MIDI GATT service) and tears
		it down again, returning the stack's RAM. Incoming notes play a
		dedicated live synth slot. When disabled, no radio code is compiled
		and the menu entry does not exist.

		Requires the NimBLE host (Component config -> Bluetooth), trimmed to
		peripheral-only so the stack costs as little internal RAM as it can:
		BT_NIMBLE_ROLE_CENTRAL=n, BT_NIMBLE_ROLE_OBSERVER=n,
		BT_NIMBLE_MAX_CONNECTIONS=1, BT_NIMBLE_GATT_SERVER=y. Pin both stack
		halves to core 0 (BT_NIMBLE_PINNED_TO_CORE_0, BT_CTRL_PINNED_TO_CORE_0)
		to keep them off the AMY render core.

config SYNTH_BLE_MIDI_LOG
	bool "Verbose BLE MIDI logging"
	depends on SYNTH_WIRELESS
	default n
	help
		Logs per-packet BLE MIDI traffic details. Diagnostic only: the log
		calls sit on the NimBLE host task in the note path, so keep this
		off outside debugging sessions.

endmenu
```

## main/Kconfig.projbuild
```kconfig
menu "User Hardware"

comment "Board pin mapping. Defaults match the upstream devkit layout;"

comment "override the ones that differ on YOUR board in sdkconfig.defaults."

config AMYSYNTH_BTN_SHOULDER_GPIO
    int "Button SW-L / SHOULDER GPIO"
    default 15

config AMYSYNTH_BTN_1_GPIO
    int "Button SW-U / 1 GPIO"
    default 18

config AMYSYNTH_BTN_2_GPIO
    int "Button SW-D / 2 GPIO"
    default 8

config AMYSYNTH_BTN_3_GPIO
    int "Button 3 / menu key GPIO"
    default 42

config AMYSYNTH_BTN_ENC1_GPIO
    int "Encoder push / ENC confirm GPIO"
    default 16

config AMYSYNTH_BTN_0_GPIO
    int "Button NAV-2 / 0 GPIO"
    default 17

config AMYSYNTH_BTN_SHIFT_GPIO
    int "Button SHIFT GPIO (note: GPIO0 = BOOT strapping)"
    default 47

config AMYSYNTH_BTN_TRANSPORT_GPIO
    int "Button transport / play-stop GPIO (-1 = disabled)"
    default -1
    help
        Optional dedicated play/stop pad that toggles playback with a single
        tap in every view. -1 (the default) disables it, and transport stays
        on MY_BUTTON_0's long-press only. Boards with a spare pad set this to
        its GPIO to gain a second, tap-to-toggle key.

config AMYSYNTH_ENCODER_A_GPIO
    int "Encoder phase A GPIO"
    default 40

config AMYSYNTH_ENCODER_B_GPIO
    int "Encoder phase B GPIO"
    default 41

config AMYSYNTH_MIDI_CLOCK_TX_GPIO
    int "MIDI clock TX GPIO (UART, -1 = disabled)"
    default -1
    range -1 48
    help
        Emits classic DIN MIDI clock on this GPIO: AMY runs as the sync
        master and its sequencer streams realtime 0xF8 (24 PPQN, tempo-locked
        to the pattern) over a UART TX at 31250 baud 8-N-1, with 0xFA/0xFC
        transport messages following the play/pause key. External gear
        (drum machines, sequencers, EFX) can then follow the groove.
        -1 (the default) disables the role entirely, so the upstream devkit
        is unaffected. Boards with a MIDI-out jack set this to its pin
        (e.g. GPIO15).

config AMYSYNTH_MIDI_IN_GPIO
    int "MIDI in GPIO (UART, -1 = disabled)"
    default -1
    range -1 48
    help
        Reads DIN-5 MIDI on this GPIO (same UART, 31250 baud 8-N-1) and plays
        incoming notes on the live-play voice - the same single performance
        slot BLE MIDI uses. External keyboards / sequencers / DAWs can then
        play the box in real time.
        -1 (the default) disables the role entirely, so the upstream devkit
        is unaffected. Boards with a MIDI-in jack set this to its pin
        (e.g. GPIO4).

comment "OLED SCL/SDA, DAC and status LED pins stay in their own"

comment "menus: Display, Audio (I2S DAC), and Status LED component."

endmenu

menu "Encoder Input"

config AMYSYNTH_ENCODER_TICKS_PER_STEP
    int "Encoder raw PCNT ticks per UI step"
    default 1
    range 1 8
    help
        How many raw PCNT counts the encoder must accumulate before the UI sees
        one step action. The driver decodes X1 (only the A-phase rising edge
        counts, direction from the B phase) so a standard mechanical encoder
        reports exactly 1 count per detent - 1 gives one clean UI move per
        notch. Leave 1 unless your encoder is a 2 or 4-count-per-detent type
        (high-resolution / dual-cycle-per-detent), then raise to match.

config AMYSYNTH_ENCODER_FLIP_DIRECTION
    bool "Flip encoder direction"
    default n
    help
        Useful when a rotated-right encoder detent is reported as a step but
        the firmware moves the cursor the wrong way (different A/B wiring or
        reversed A/B pins).

endmenu

menu "Audio Diagnostics"

config USB_AUDIO_DIAGNOSTICS
	bool "Enable USB audio diagnostics"
	default n
	help
		Compiles in USB audio diagnostic counters and periodic log snapshots.
		When enabled, the firmware tracks ring-buffer fill level, underrun events,
		overrun/drop events, and peak written sample magnitude.

endmenu

menu "USB Audio Behavior"

config USB_AUDIO_BLOCKING_WRITE
    bool "Block render task when USB buffer is full"
    default n
    help
        If enabled, the AMY render task will wait (retry with backoff) until 
        the USB ring buffer has space, effectively slave-clocking the synth
        to the PC's consumption rate. 
        If disabled (default), the task will drop overflowed blocks to
        maintain real-time AMY clock alignment regardless of USB health,
        which can result in 'honky' percussive artifacts if transport is poor.

config OUTPUT_WATCHDOG
    bool "Output level watchdog (UI badge on stuck-loud / clipping output)"
    default y
    help
        Detects output that is continuously at clipping level (~0.5 s) or
        sustained near full scale (~2.5 s, e.g. filter self-oscillation or a
        stuck voice) and shows a small CLIP/LOUD badge in the UI. The check
        peeks at the most recent audio already committed to the USB ring
        buffer from the UI task on Core 0 every 50 ms; the render task and
        Core 1 do no extra work.

config FILTER_SCOPE
    bool "Live filter overlay in the filter editor (filter scope)"
    default y
    help
        Draws a live band on the filter editor's response curve showing where
        the filter cutoff is actually travelling, so EG1 sweeps and filter LFO
        motion are visible instead of having to be inferred from the authored
        numbers.

        This does not sample audio: AMY already computes the modulated cutoff
        as a control-rate scalar once per block, and the render task publishes
        min/max of it into a small cell that the UI drains at 20 Hz. The
        accumulator is armed only while the filter editor is open; when it is
        closed the render task does one load and one branch per block.

endmenu

menu "Render Clock Source"

config RENDER_CLOCK_I2S_ENABLE
    bool "Use I2S DMA backpressure as the render clock (experimental)"
    default n
    help
        Selects an alternate render-clock backend: main/render_clock_i2s.c
        instead of the default main/render_clock.c (GPTimer). The render
        task's timing seam is paced by blocking i2s_channel_write() calls
        to an I2S TX channel configured with every GPIO left unassigned
        (I2S_GPIO_UNUSED), so this changes no pin mux and produces no
        physical signal -- the peripheral's internal clock divider free-runs
        and drains its DMA queue on schedule regardless of GPIO routing,
        and that DMA drain is the only thing this backend uses.

        The I2S TX DMA queue (see RENDER_CLOCK_I2S_DMA_DESC_NUM) gives the
        render task up to (queue depth - 1) block periods of look-ahead
        before a write blocks, trading the GPTimer path's strict zero-slack
        pacing for extra scheduling headroom against a transient overrun.
        One consequence: the GPTimer path's counting overrun signal
        (render_clock_wait() returning >1) does not exist here --
        this backend always returns 1, so s_render_overruns stays 0
        regardless of actual render-task headroom.

        Leave this off (default) to keep the proven GPTimer path fully
        intact. This is a prototype for deliberate, opt-in evaluation, not
        a proven replacement; trace the full clock/DMA impact before
        enabling on hardware.

config RENDER_CLOCK_I2S_DMA_DESC_NUM
    int "I2S TX DMA buffer count (buffer depth)"
    depends on RENDER_CLOCK_I2S_ENABLE
    default 2
    range 2 8
    help
        Number of DMA descriptors (buffers) in the I2S TX ring, each sized
        to exactly one AMY render block (AMY_BLOCK_SIZE frames). This is
        the "double buffer depth" lever: 2 (the default, "double buffering")
        gives one block period (~5.3 ms) of render-task look-ahead before
        i2s_channel_write() blocks; higher values trade more look-ahead
        headroom for more worst-case latency between an actual overrun and
        its effect becoming audible/measurable.

endmenu

# The heap / RTOS / render-timing diagnostic menus moved to
# components/diagnostics/Kconfig, alongside the code they gate. Symbol names
# are unchanged; they now appear under Component config -> Diagnostics.
```
