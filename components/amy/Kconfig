## components/amy/Kconfig
```kconfig
menu "AMY Synthesizer"

config AMY_USE_FIXEDPOINT
    bool "Use fixed-point arithmetic (s8.23 / s.31)"
    default y
    help
        When enabled (default), AMY uses integer fixed-point arithmetic
        (SAMPLE = s8.23, PHASOR = s.31) instead of single-precision float.

        The ESP32-S3 Xtensa LX7 has a hardware FPU. In practice, float and
        fixed-point perform similarly for most voice counts, but float mode
        may be worth testing. Note: float mode replaces the integer shifts
        inside log2_lut/exp2_lut with ldexpf() calls; ensure you verify
        CPU headroom after switching.

choice AMY_PROFILE_MODE
    prompt "AMY DSP profiling"
    default AMY_PROFILE_OFF
    help
        Instruments the AMY render path with esp_timer timestamps so the
        per-stage CPU cost can be read on-target. Used to measure the
        parallelizable fraction (osc render vs. serial FX/fill_buffer)
        before deciding whether dual-core rendering is worthwhile.

config AMY_PROFILE_OFF
    bool "Off (no profiling, zero overhead)"
    help
        Production default. AMY_PROFILE_START/STOP compile to nothing.

config AMY_PROFILE_COARSE
    bool "Coarse (block-level: render / fill_buffer / deltas)"
    help
        Times only the outer render stages (AMY_RENDER, AMY_FILL_BUFFER,
        AMY_EXECUTE_DELTAS, AMY_ESP_FILL_BUFFER). The per-osc/inner tags
        compile to nothing, so the AMY_RENDER total is NOT inflated by the
        profiler's own timestamp calls. This is the mode to use for the
        Amdahl (parallelizable-fraction) measurement: overhead is ~8
        esp_timer reads per block (<0.1% of the block budget).

config AMY_PROFILE_FULL
    bool "Full (per-osc breakdown, defines AMY_DEBUG)"
    help
        Enables every AMY profiler tag, including per-osc tags that fire
        dozens of times per block INSIDE the AMY_RENDER window. Useful to
        see WHERE render time goes (osc wave vs. filter vs. mix), but the
        per-osc timestamp calls inflate the AMY_RENDER total and overstate
        the parallelizable fraction. Do not use its ratio as the go/no-go
        number; use COARSE for that.

endchoice

config AMY_WAVETABLE
    bool "Enable wavetable oscillator (wave=WAVETABLE)"
    default y
    help
        Compiles in AMY's 64-cycle wavetable oscillator (wave constant
        WAVETABLE) and its 5 built-in tables (111.WAV, BRAIDS01.WAV,
        PPG_WA00.WAV, SINE2SAW.WAV, VIRAL.WAV; 16384 samples each). Each
        table is played back by a phase accumulator driven purely by
        AMY_SAMPLE_RATE, independent of the 22050 Hz rate the source
        waveforms were captured at; `duty` selects/crossfades between the
        64 cycles within the chosen table (scan position).

        Measured cost (2026-07, esp32s3, 16 MB flash): ~160 KB added to
        flash .rodata (const int16_t sample data, XIP-cached, never RAM- or
        PSRAM-copied — pcm_get_sample_ram_for_preset() returns a pointer
        straight into flash). Zero internal DRAM, zero PSRAM, zero IRAM
        impact: the render path (render_wavetable()) borrows the existing
        LUT renderer and adds no new hot-path code of its own. Safe to
        leave on; disable only under severe flash pressure.

config AMY_PROFILE_INTERVAL_MS
    int "Profiler dump interval (ms)"
    depends on !AMY_PROFILE_OFF
    default 5000
    range 500 60000
    help
        How often the accumulated profile is printed to the console and
        reset. Each dump reports per-stage us/block and % of wall time over
        the elapsed window.

endmenu
```

## components/display/Kconfig
```kconfig
menu "PRIV I2C U8G2 Component"

    config I2C_U8G2_I2C_PORT
        int "I2C Port Number"
        default 0
        help
            I2C controller index (for example 0 for I2C_NUM_0).

    config I2C_U8G2_SCL_GPIO
        int "SCL GPIO Number"
        default 5
        help
            GPIO number for I2C clock.

    config I2C_U8G2_SDA_GPIO
        int "SDA GPIO Number"
        default 4
        help
            GPIO number for I2C data.

    choice I2C_U8G2_PANEL
        prompt "OLED panel"
        default I2C_U8G2_PANEL_SSD1315
        help
            u8g2 controller setup. The 0.96-inch 128x64 panels are
            SSD1306/SSD1315; the 1.3-inch 128x64 panels are SH1106.

        config I2C_U8G2_PANEL_SSD1315
            bool "SSD1306/SSD1315 0.96\" 128x64"
            help
                Use u8g2_Setup_ssd1315_i2c_128x64_noname_f (default).

        config I2C_U8G2_PANEL_SH1106
            bool "SH1106 1.3\" 128x64"
            help
                Use u8g2_Setup_sh1106_i2c_128x64_noname_f.
    endchoice

    config I2C_U8G2_FREQ_HZ
        int "I2C Bus Frequency (Hz)"
        default 400000
        help
            I2C bus speed in Hertz.

    config I2C_U8G2_TIMEOUT_MS
        int "I2C Transaction Timeout (ms)"
        default 1000
        help
            Timeout used for display I2C transactions.

    config I2C_U8G2_DISPLAY_ADDRESS
        hex "Display I2C Address"
        range 0x00 0x7F
        default 0x3C
        help
            7-bit I2C address of the display device.

    config I2C_U8G2_INTERNAL_PULLUP
        bool "Enable internal SDA/SCL pull-ups"
        default y
        help
            Enable internal pull-up resistors for SDA/SCL pins.

endmenu
```

## components/harness/Kconfig
```kconfig
menu "DEV Serial Harness"

    config DEV_SERIAL_HARNESS
        bool "Serial test harness (scripted control channel on UART0)"
        default n
        help
            Compiles in the agent/script-drivable test harness: a low-priority
            command task reading line commands from UART0 (H> prefix) to
            inject input events, drive the transport and dump state, for the
            headless test board. No harness code is compiled in when off;
            the playable firmware is unaffected.

endmenu
```

## components/i2s_dac/Kconfig
```kconfig
menu "I2S DAC Output"

config AMYSYNTH_I2S_DAC
	bool "PCM5102 I2S DAC output"
	default n
	help
		Drives the board's PCM5102 DAC as the active audio egress. With this
		on, every rendered AMY block is also written to the I2S TX channel
		(BCK / LRCK / DIN), so the synth sounds standalone without a USB
		host. USB audio (UAC2) is not affected and keeps working alongside
		it. Off by default so the upstream devkit (OLED on SCL=5) is not
		affected; enable it on boards that route these pins to a DAC.

config AMYSYNTH_I2S_DAC_BCLK_GPIO
	int "I2S BCK (bit clock) GPIO"
	depends on AMYSYNTH_I2S_DAC
	default 5
	help
		PCM5102 BCK pin. Hardware wiring "DAC PCM5102": BCK = IO5.

config AMYSYNTH_I2S_DAC_WS_GPIO
	int "I2S WS / LRCK (word select) GPIO"
	depends on AMYSYNTH_I2S_DAC
	default 7
	help
		PCM5102 LRCK pin. Hardware wiring "DAC PCM5102": LRCK = IO7.

config AMYSYNTH_I2S_DAC_DOUT_GPIO
	int "I2S DOUT (serial data) GPIO"
	depends on AMYSYNTH_I2S_DAC
	default 6
	help
		PCM5102 DIN pin. Hardware wiring "DAC PCM5102": DIN = IO6.

config AMYSYNTH_I2S_DAC_MCLK_GPIO
	int "I2S MCLK (system clock) GPIO, -1 = unused"
	depends on AMYSYNTH_I2S_DAC
	default -1
	help
		Optional MCLK line. Most PCM5102 modules auto-detect SCK from BCK,
		so this is left unconnected by default (-1 = I2S_GPIO_UNUSED). If
		your module needs a real SCK, wire SCK to a spare GPIO and set it
		here.

config AMYSYNTH_I2S_DAC_DMA_DESC_NUM
	int "I2S TX DMA descriptor count (buffer depth)"
	depends on AMYSYNTH_I2S_DAC
	default 4
	range 2 8
	help
		Number of DMA descriptors in the I2S TX ring, each sized to one AMY
		render block. More descriptors tolerate transient render jitter
		before a write drops a block, at the cost of extra output latency.

endmenu
```

## components/midi_clock_slave/Kconfig
```kconfig
menu "MIDI Clock Slave"

config AMYSYNTH_MIDI_CLOCK_SLAVE
    bool "Follow external MIDI Clock (slave mode)"
    default n
    help
        When a master (DAW, drum machine, or a MIDI keyboard) sends a
        running MIDI timing clock on the DIN port or via BLE MIDI, the
        sequencer locks its tempo to the master instead of the internal
        BPM. The inter-tick interval (24 ticks per quarter note) is
        EMA-smoothed and fits the sequencer's BPM range (40..300).

        Song start/continue (0xFA / 0xFB) and stop (0xFC) drive the local
        transport, but only while a live clock stream has been seen, so a
        keyboard that never sends clock cannot hijack the transport.

        Disabled by default so the stock devkit behaviour is unchanged;
        the board enables it in sdkconfig.defaults.

        Tempo lock only - song position pointer (0xF2) and sample-accurate
        re-phase of the sequencer steps are not implemented.

endmenu
```

## components/perf_pots/Kconfig
```kconfig
menu "Performance Pots"

config AMYSYNTH_POT_CUTOFF_GPIO
    int "Filter-cutoff pot GPIO (ADC1 channel, -1 = disabled)"
    default -1
    range -1 10
    help
        Analog performance controls read from the ESP32-S3 ADC1 unit
        (GPIO1..10; one channel per pot). A low-priority task samples each
        enabled pin at ~20 Hz, smooths it, and pushes the value into the
        synth only when it moves past a small deadband.
        -1 (the default) disables the role, so the upstream devkit is
        unaffected; boards with spare ADC1 pads set the pins here.
        Each symbol defaults to -1; all three can coexist.

config AMYSYNTH_POT_FX_GPIO
    int "FX pot GPIO (ADC1 channel, -1 = disabled)"
    default -1
    range -1 10
    help
        Acts as a MIDI CC1 mod wheel into the wireless live-play slot when
        the wireless synth is compiled in: the 20 Hz live_play LFO stepper
        turns the position into a ~4 Hz osc-0 vibrato (depth ramps up to +-1
        semitone at full travel, 0 = no vibrato). Without the wireless synth
        (upstream devkit) it maps onto the global echo + reverb sends
        (0..100%) instead.

config AMYSYNTH_POT_VOLUME_GPIO
    int "Master-volume pot GPIO (ADC1 channel, -1 = disabled)"
    default -1
    range -1 10
    help
        Maps the pot onto AMY's global master volume (0..2x, unity in the
        middle). Directly scales the rendered mix before it reaches any
        output.

endmenu
```

## components/status_led/Kconfig
```kconfig
menu "Status LED"

config AMYSYNTH_STATUS_LED
    bool "Onboard RGB LED shows Core-1 (render) load"
    default y
    help
        Drives the board's onboard addressable RGB LED (WS2812) as a
        render-load indicator. Core-1 busy share maps to color bands:
        green < 50%, yellow >= 50%, orange >= 75%, red >= 90%, with
        hysteresis at the band edges. The LED is only rewritten when the
        band changes, so steady-state cost is one load sample per period.

        The load metric is core_load_sample() in the diagnostics
        component: idle-hook invocation counting, one counter increment
        per idle-loop pass - no kernel critical sections. (Its
        uxTaskGetSystemState() predecessor masked interrupts for the task
        walk and caused 1-2 ms USB audio holes on the 1 s sample grid;
        see core_load.h. This option no longer selects any FreeRTOS
        stats machinery.)

config AMYSYNTH_STATUS_LED_GPIO
    int "LED data GPIO"
    depends on AMYSYNTH_STATUS_LED
    default 48
    help
        Data line of the onboard addressable LED. ESP32-S3-DevKitC-1
        v1.0 boards route it to GPIO48, v1.1 boards to GPIO38.

config AMYSYNTH_STATUS_LED_BRIGHTNESS
    int "Brightness (1-255)"
    depends on AMYSYNTH_STATUS_LED
    range 1 255
    default 12
    help
        Full-scale color values are scaled by BRIGHTNESS/255 before being
        written to the LED. Keep low: the onboard LED is bright, and very
        low values (< ~8) start to lose the yellow/orange distinction to
        8-bit channel quantization.

config AMYSYNTH_STATUS_LED_PERIOD_MS
    int "Load sample period (ms)"
    depends on AMYSYNTH_STATUS_LED
    range 200 5000
    default 1000
    help
        Interval between core-load samples. The displayed load is the mean
        over this window (spikes shorter than the window average out; use
        the render_stats diagnostic for per-block spike analysis).

config AMYSYNTH_STATUS_LED_ALLOC_BLINK
    bool "Blink on failed heap allocation"
    depends on AMYSYNTH_STATUS_LED
    default y
    help
        Registers heap_caps_register_failed_alloc_callback() and answers
        any failed allocation with a short magenta blink burst before the
        LED returns to the load color. Note the callback fires on EVERY
        failed alloc, including the first leg of deliberate
        internal-then-PSRAM fallback paths, so an occasional blink can be
        a graceful degrade rather than a hard OOM.

endmenu
```
